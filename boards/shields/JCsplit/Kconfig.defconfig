## boards/shields/JCsplit/Kconfig.defconfig
```kconfig
if SHIELD_JCSPLIT_LEFT
  config ZMK_KEYBOARD_NAME
    default "JCsplit"
  config ZMK_SPLIT_ROLE_CENTRAL
    default y
endif

if SHIELD_JCSPLIT_LEFT || SHIELD_JCSPLIT_RIGHT
  config ZMK_SPLIT
    default y
endif
```

## boards/shields/JCsplit/Kconfig.shield
```kconfig
config SHIELD_JCSPLIT_LEFT
    def_bool $(shields_list_contains,JCsplit_left)

config SHIELD_JCSPLIT_RIGHT
    def_bool $(shields_list_contains,JCsplit_right)
```
