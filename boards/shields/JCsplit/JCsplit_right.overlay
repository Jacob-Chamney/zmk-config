#include "JCsplit.dtsi"

&kscan0 {


  col-gpios = 
      <&gpio0 24 (GPIO_ACTIVE_HIGH)>, //C5
      <&gpio0 22 (GPIO_ACTIVE_HIGH)>, //C4
      <&gpio0 20 (GPIO_ACTIVE_HIGH)>, //C3
      <&gpio0 17 (GPIO_ACTIVE_HIGH)>, //C2
      <&gpio0 8 (GPIO_ACTIVE_HIGH)>, //C1
      <&gpio0 6 (GPIO_ACTIVE_HIGH)>; //C0

};

&default_transform {
  col-offset = <6>;
};
